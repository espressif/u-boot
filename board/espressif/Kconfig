## board/espressif/Kconfig
```kconfig
if ARCH_ESPRESSIF

config TARGET_ESP32S31
    bool "ESP32-S31"
    default y

if TARGET_ESP32S31
source "board/espressif/esp32s31/Kconfig"
endif

endif
```

## board/espressif/esp32s31/Kconfig
```kconfig
if TARGET_ESP32S31

config SYS_BOARD
	default "esp32s31"

config SYS_VENDOR
	default "espressif"

config SYS_CPU
	default "generic"

config SYS_CONFIG_NAME
	default "esp32s31"

config BOARD_SPECIFIC_OPTIONS
	def_bool y
	select GENERIC_RISCV
	select SUPPORT_SPL

endif
```

## configs/espressif_esp32s31_defconfig
```kconfig
CONFIG_RISCV=y
CONFIG_SYS_ICACHE_OFF=y
CONFIG_SYS_DCACHE_OFF=y
CONFIG_TEXT_BASE=0x50400000
CONFIG_SYS_MALLOC_LEN=0x18000
CONFIG_SYS_MALLOC_F_LEN=0x2000
CONFIG_NR_DRAM_BANKS=2
CONFIG_HAS_CUSTOM_SYS_INIT_SP_ADDR=y
CONFIG_CUSTOM_SYS_INIT_SP_ADDR=0x2F07F000
CONFIG_ENV_SIZE=0x2000
CONFIG_DEFAULT_DEVICE_TREE="esp32s31"
CONFIG_SPL_TEXT_BASE=0x2F040000
CONFIG_SPL_SYS_MALLOC_F_LEN=0x20000
CONFIG_SPL_BSS_START_ADDR=0x2F050000
CONFIG_SPL_BSS_MAX_SIZE=0x8000
CONFIG_SPL=y
CONFIG_SYS_LOAD_ADDR=0x50000000
CONFIG_ARCH_ESPRESSIF=y
CONFIG_SPL_OPENSBI_LOAD_ADDR=0x2F000000
CONFIG_CMODEL_MEDANY=y
CONFIG_RISCV_SMODE=y
# CONFIG_RISCV_ISA_F is not set
CONFIG_FIT=y
# CONFIG_BOOTSTD is not set
CONFIG_BOOTDELAY=0
CONFIG_USE_BOOTCOMMAND=y
CONFIG_BOOTCOMMAND="booti 0x40400000 - 0x40200000"
CONFIG_BOARD_LATE_INIT=y
CONFIG_SPL_MAX_SIZE=0x20000
CONFIG_SPL_BOARD_INIT=y
CONFIG_SPL_NOR_SUPPORT=y
# CONFIG_AUTO_COMPLETE is not set
# CONFIG_SYS_LONGHELP is not set
CONFIG_SYS_PROMPT="esp32s31> "
# CONFIG_CMD_CONSOLE is not set
# CONFIG_CMD_BOOTD is not set
# CONFIG_CMD_BOOTM is not set
# CONFIG_CMD_ELF is not set
# CONFIG_CMD_FDT is not set
# CONFIG_CMD_GO is not set
# CONFIG_CMD_IMI is not set
# CONFIG_CMD_XIMG is not set
# CONFIG_CMD_CRC32 is not set
CONFIG_CMD_MEMTEST=y
# CONFIG_CMD_LZMADEC is not set
# CONFIG_CMD_UNLZ4 is not set
# CONFIG_CMD_UNZIP is not set
# CONFIG_CMD_DM is not set
# CONFIG_CMD_LOADB is not set
# CONFIG_CMD_LOADS is not set
# CONFIG_CMD_SOURCE is not set
# CONFIG_CMD_SETEXPR is not set
CONFIG_OF_BOARD=y
# CONFIG_NET is not set
CONFIG_SPL_CLK=y
CONFIG_ESP_SERIAL=y
# CONFIG_SHA256 is not set
# CONFIG_GZIP is not set
# CONFIG_EFI_LOADER is not set
```
